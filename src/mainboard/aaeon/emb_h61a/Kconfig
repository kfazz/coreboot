## src/mainboard/aaeon/emb_h61a/Kconfig
```kconfig
if BOARD_AAEON_EMB_H61A

config BOARD_SPECIFIC_OPTIONS
	def_bool y
	select BOARD_ROMSIZE_KB_8192
	select HAVE_ACPI_RESUME
	select HAVE_ACPI_TABLES
	select INTEL_INT15
	select MAINBOARD_HAS_LIBGFXINIT # FIXME: check this
	select NORTHBRIDGE_INTEL_SANDYBRIDGE
	select SERIRQ_CONTINUOUS_MODE
	select SOUTHBRIDGE_INTEL_BD82X6X
	select USE_NATIVE_RAMINIT

config MAINBOARD_DIR
	string
	default aaeon/emb_h61a

config MAINBOARD_PART_NUMBER
	string
	default "EMB-H61A"

config VGA_BIOS_FILE
	string
	default "pci8086,0152.rom"

config VGA_BIOS_ID
	string
	default "8086,0152"

config DRAM_RESET_GATE_GPIO # FIXME: check this
	int
	default 60

config USBDEBUG_HCD_INDEX # FIXME: check this
	int
	default 2
endif
```

## src/mainboard/apple/appletv11/Kconfig
```kconfig
if BOARD_APPLE_APPLETV11

config BOARD_SPECIFIC_OPTIONS # dummy
	def_bool y
	select SYSTEM_TYPE_LAPTOP
	select ARCH_X86
	select CPU_INTEL_SOCKET_BGA663
	select UDELAY_LAPIC
	select NORTHBRIDGE_INTEL_I945
	select NORTHBRIDGE_INTEL_SUBTYPE_I945GM
	select SOUTHBRIDGE_INTEL_I82801GX
	select DRIVERS_I2C_CK505
	select HAVE_OPTION_TABLE
	select HAVE_CMOS_DEFAULT
	select BOARD_ROMSIZE_KB_2048
	select CHANNEL_XOR_RANDOMIZATION
	select HAVE_ACPI_TABLES
	select HAVE_ACPI_RESUME
	select USE_OPTION_TABLE

config MAINBOARD_DIR
	string
	default apple/appletv11

config MAINBOARD_PART_NUMBER
	string
	default "Appletv1,1" if BOARD_APPLE_APPLETV11

config MAX_CPUS
	int
	default 1

config MAINBOARD_SMBIOS_MANUFACTURER
	string
	default "Apple Inc."

config MAXIMUM_SUPPORTED_FREQUENCY
	int
	default 400

endif
```

## src/mainboard/dell/optiplex_790/Kconfig
```kconfig
##
## This file is part of the coreboot project.
##
## Copyright (C) 2012 Alexandru Gagniuc <mr.nuke.me@gmail.com>
## Copyright (C) 2009-2010 coresystems GmbH
##
## This program is free software; you can redistribute it and/or modify
## it under the terms of the GNU General Public License as published by
## the Free Software Foundation; version 2 of the License.
##
## This program is distributed in the hope that it will be useful,
## but WITHOUT ANY WARRANTY; without even the implied warranty of
## MERCHANTABILITY or FITNESS FOR A PARTICULAR PURPOSE.  See the
## GNU General Public License for more details.
##

if BOARD_DELL_OPTIPLEX_790

config BOARD_SPECIFIC_OPTIONS # dummy
	def_bool y
	select BOARD_ROMSIZE_KB_10240
	select CPU_INTEL_SOCKET_LGA1155
	select HAVE_ACPI_RESUME
	select HAVE_ACPI_TABLES
	select INTEL_INT15
	select NORTHBRIDGE_INTEL_SANDYBRIDGE
	select SERIRQ_CONTINUOUS_MODE
	select SOUTHBRIDGE_INTEL_BD82X6X
	select USE_NATIVE_RAMINIT

config HAVE_IFD_BIN
	bool
	default n

config HAVE_ME_BIN
	bool
	default n

config MAINBOARD_DIR
	string
	default dell/optiplex_790

config MAINBOARD_PART_NUMBER
	string
	default "OptiPlex 790"

config VGA_BIOS_FILE
	string
	default "pci8086,0102.rom" # When this section is removed,
				   #the nconfig and build process starts behaving weird

config VGA_BIOS_ID
	string
	default "8086,0102"

config MAINBOARD_PCI_SUBSYSTEM_DEVICE_ID
	hex
	default 0x4ad

config MAINBOARD_PCI_SUBSYSTEM_VENDOR_ID
	hex
	default 0x1028

config MAX_CPUS
	int
	default 8

config USBDEBUG_HCD_INDEX # FIXME: check this
	int
	default 2

endif
```

## src/mainboard/dell/optiplex_990/Kconfig
```kconfig
if BOARD_DELL_OPTIPLEX_990

config BOARD_SPECIFIC_OPTIONS
	def_bool y
	select BOARD_ROMSIZE_KB_10240
	select HAVE_ACPI_RESUME
	select HAVE_ACPI_TABLES
	select INTEL_INT15
	select NORTHBRIDGE_INTEL_SANDYBRIDGE
	select SUPERIO_SMSC_SCH5545
        select HAVE_OPTION_TABLE
        select HAVE_CMOS_DEFAULT
	select SERIRQ_CONTINUOUS_MODE
	select SOUTHBRIDGE_INTEL_BD82X6X
	select USE_NATIVE_RAMINIT
	select MAINBOARD_HAS_LIBGFXINIT
	select INTEL_GMA_HAVE_VBT
	select MAINBOARD_USES_IFD_GBE_REGION

config MAINBOARD_DIR
	string
	default dell/optiplex_990

config MAINBOARD_PART_NUMBER
	string
	default "OptiPlex 990"

config VGA_BIOS_FILE
	string
	default "pci8086,0102.rom"

config VGA_BIOS_ID
	string
	default "8086,0102"

config MAINBOARD_PCI_SUBSYSTEM_DEVICE_ID
	hex
	default 0x47e

config MAINBOARD_PCI_SUBSYSTEM_VENDOR_ID
	hex
	default 0x1028

config DRAM_RESET_GATE_GPIO # FIXME: check this
	int
	default 60

config MAX_CPUS
	int
	default 8

config USBDEBUG_HCD_INDEX
	int
	default 2

config INCLUDE_SMSC_SCH5545_EC_FW
        bool "Include SMSC SCH5545 EC firmware binary"
        default n
        help
          This option allows to add the SMSC SCH5545 Environmental Controller
          firmware binary. The firmware must be loaded after each power failure
          in order to properly initialize the fan control, because EC loses its
          configuration when power is cut off. Otherwise the fans will keep
          running at full speed after power failure.

config SMSC_SCH5545_EC_FW_FILE
        string "File path to the SMSC SCH5545 EC firmware binary"
        depends on INCLUDE_SMSC_SCH5545_EC_FW

endif
```

## src/mainboard/to_be_filled_by_o.e.m/Kconfig
```kconfig
if VENDOR_TO_BE_FILLED_BY_O.E.M

choice
	prompt "Mainboard model"

source "src/mainboard/to_be_filled_by_o.e.m/*/Kconfig.name"

endchoice

source "src/mainboard/to_be_filled_by_o.e.m/*/Kconfig"

config MAINBOARD_VENDOR
	string
	default "To be filled by O.E.M."

endif # VENDOR_TO_BE_FILLED_BY_O.E.M
```

## src/mainboard/to_be_filled_by_o.e.m/to_be_filled_by_o.e.m/Kconfig.name
```kconfig
config BOARD_TO_BE_FILLED_BY_O.E.M_TO_BE_FILLED_BY_O.E.M
	bool "To be filled by O.E.M."
```
